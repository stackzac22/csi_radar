## main/Kconfig.projbuild
```kconfig
menu "CSI Radar Configuration"

    choice CSI_ROLE
        prompt "Device Role"
        default CSI_ROLE_RX
        help
            Select whether this device acts as a transmitter or a receiver.

        config CSI_ROLE_TX
            bool "Transmitter (TX)"
            help
                Broadcasts ESP-NOW pulses to trigger CSI collection on receivers.

        config CSI_ROLE_RX
            bool "Receiver (RX)"
            help
                Listens for ESP-NOW pulses, collects CSI data, streams to host.
    endchoice

    config DEVICE_ID
        string "Device ID"
        default "node-01"
        help
            Unique label for this device in JSON output and log messages.
            Examples: rx-xiao, tx-atoms3, tx-wroom-01, tx-c5-dongle

    config WIFI_CHANNEL
        int "WiFi channel"
        default 1
        range 1 177
        help
            WiFi channel used for CSI collection and ESP-NOW.
            Channels 1-13 are 2.4 GHz. Channels 36+ are 5 GHz (ESP32-C5 only).

    config WIFI_SSID
        string "Wi-Fi SSID (RX only)"
        default "myssid"
        depends on CSI_ROLE_RX
        help
            SSID of the network the RX device connects to for HTTP notifications.

    config WIFI_PASSWORD
        string "Wi-Fi Password (RX only)"
        default "mypassword"
        depends on CSI_ROLE_RX
        help
            Password for the above network.

    config MQTT_BROKER_URI
        string "MQTT broker URI (RX only)"
        default "mqtt://100.64.0.1:1883"
        depends on CSI_ROLE_RX
        help
            URI of the MQTT broker (mosquitto on the RPi 4B) that motion events
            are published to. Set to the RPi Tailscale IP, e.g.
            mqtt://100.x.x.x:1883

    config MQTT_MOTION_TOPIC
        string "MQTT motion topic (RX only)"
        default "csi/motion"
        depends on CSI_ROLE_RX
        help
            Topic the RX publishes motion alerts to. The payload is a JSON
            object with trigger/id/chip/diff and, when the camera is enabled,
            the snapshot and stream URLs the device serves.

    config ENABLE_CAMERA
        bool "Onboard camera snapshot server (RX only)"
        default y
        depends on CSI_ROLE_RX && IDF_TARGET_ESP32S3
        help
            XIAO ESP32-S3 Sense only. Initialises the onboard OV2640 and serves
            /snapshot (single JPEG) and /stream (MJPEG) over HTTP on port 80.
            On motion, the snapshot URL is included in the MQTT alert so a
            subscriber can grab the frame. Requires PSRAM (enabled via
            sdkconfig.defaults.rx-camera). Disable for RX boards without a
            camera, e.g. the Cardputer.

    config CSI_SERIAL_OUTPUT
        bool "Stream CSI frames over serial (JSON)"
        default y
        depends on CSI_ROLE_RX
        help
            Output each CSI frame as a newline-delimited JSON object on stdout.
            The RPi reads this via USB serial (/dev/ttyUSB0) for visualization
            and gesture classification. Disable for standalone motion-only mode.

    config MOTION_THRESHOLD
        int "Motion detection threshold (x10)"
        default 150
        range 10 5000
        help
            CSI magnitude variance threshold for motion detection, scaled x10.
            Default 150 = 15.0. Increase to reduce false positives.

    config DEBOUNCE_MS
        int "Motion debounce time (ms)"
        default 5000
        range 500 60000
        help
            Minimum milliseconds between motion alert notifications.

endmenu
```

## sdkconfig.defaults
```kconfig
# ── Common defaults for all CSI Radar builds ──────────────────────────────────
# Applied to all targets. Target-specific overrides go in sdkconfig.defaults.<target>
# Device-specific settings (SSID, password, notify URL, role, device ID)
# must be set via: idf.py -B build/<dir> menuconfig

CONFIG_ESP_WIFI_CSI_ENABLED=y

# Increase log buffer for JSON serial output
CONFIG_LOG_DEFAULT_LEVEL_INFO=y

# Increase main task stack for HTTP client
CONFIG_ESP_MAIN_TASK_STACK_SIZE=8192
```

## sdkconfig.defaults.esp32
```kconfig
# ── ESP32 (WROOM) overrides ───────────────────────────────────────────────────
# Xtensa LX6, 2.4 GHz only
# CSI: LLTF = 52 subcarriers (HT20), HTLTF = 56 (HT20)
# No 5 GHz. Keep CONFIG_WIFI_CHANNEL = 1

# Reduce log to free flash on WROOM (4 MB flash typical)
CONFIG_LOG_DEFAULT_LEVEL_WARN=y
```

## sdkconfig.defaults.esp32c5
```kconfig
# ── ESP32-C5 overrides ────────────────────────────────────────────────────────
# RISC-V, 2.4 GHz + 5 GHz (WiFi 6 / 802.11ax)
# Used on: Waveshare C5 dev board (TX), LilyGo T-Dongle C5 (TX)
#
# 5 GHz operation:
#   Change CONFIG_WIFI_CHANNEL to a 5 GHz channel (36, 40, 44, 48, 149, 153, 157, 161)
#   via: idf.py -B build/tx-esp32c5 menuconfig → CSI Radar Configuration → WiFi channel
#
# Uses wifi_csi_acquire_config_t (HE bitfield struct) instead of bool struct.
# The firmware handles this automatically via #ifdef CONFIG_SOC_WIFI_HE_SUPPORT.

CONFIG_ESP_SYSTEM_PANIC_PRINT_REBOOT=y

# The C5 carries the dual-band (2.4/5 GHz) Wi-Fi stack, so its app image is
# ~1.06 MB — larger than the esp32/esp32s3 TX images and over the default 1 MB
# single-app partition. Use the large single-app layout (~1.5 MB app) so it
# fits. The Waveshare/T-Dongle C5 modules ship with >=4 MB flash.
CONFIG_ESPTOOLPY_FLASHSIZE_4MB=y
CONFIG_PARTITION_TABLE_SINGLE_APP_LARGE=y
```

## sdkconfig.defaults.esp32s3
```kconfig
# ── ESP32-S3 overrides ────────────────────────────────────────────────────────
# Xtensa LX7, 2.4 GHz only
# CSI: LLTF = 52 subcarriers (HT20) — higher quality than classic ESP32
# Used on: M5 Atom S3 (TX), AtomFly (TX), XIAO ESP32-S3 Sense (RX), Cardputer (RX)

CONFIG_ESP_SYSTEM_PANIC_PRINT_REBOOT=y
```

## sdkconfig.defaults.rx-camera
```kconfig
# ── RX + camera build (XIAO ESP32-S3 Sense) ──────────────────────────────────
# Applied ONLY to the rx-esp32s3 variant by build_all.sh, on top of
# sdkconfig.defaults + sdkconfig.defaults.esp32s3. Keeps PSRAM/camera config
# off the Atom S3 TX build, which shares the esp32s3 target but has no PSRAM.

# Octal PSRAM — required for the OV2640 frame buffer
CONFIG_SPIRAM=y
CONFIG_SPIRAM_MODE_OCT=y
CONFIG_SPIRAM_SPEED_80M=y
CONFIG_SPIRAM_FETCH_INSTRUCTIONS=y
CONFIG_SPIRAM_RODATA=y
# Don't hard-fault if PSRAM is ever absent — log and continue
CONFIG_SPIRAM_IGNORE_NOTFOUND=y

# 8 MB flash + a larger app partition (camera + mqtt + http server + wifi)
CONFIG_ESPTOOLPY_FLASHSIZE_8MB=y
CONFIG_PARTITION_TABLE_SINGLE_APP_LARGE=y

# Run the CPU flat-out; camera + CSI capture are both timing sensitive
CONFIG_ESP_DEFAULT_CPU_FREQ_MHZ_240=y
```
